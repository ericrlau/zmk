/*
 * Copyright (c) 2020 The ZMK Contributors
 *
 * SPDX-License-Identifier: MIT
 */

#include <behaviors.dtsi>
#include <dt-bindings/zmk/keys.h>
#include <dt-bindings/zmk/bt.h>
#include <dt-bindings/zmk/ext_power.h>


/ {
	keymap {
		compatible = "zmk,keymap";

		default_layer {
// ------------------------------------------------------------------------------------------------------------
// |  ESC  |  1  |  2  |  3   |  4   |  5   |                   |  6   |  7    |  8    |  9   |   0   |   `   |
// |  TAB  |  Q  |  W  |  E   |  R   |  T   |                   |  Y   |  U    |  I    |  O   |   P   |   -   |
// |  CTRL |  A  |  S  |  D   |  F   |  G   |                   |  H   |  J    |  K    |  L   |   ;   |   '   |
// | SHIFT |  Z  |  X  |  C   |  V   |  B   |   "["  |  |  "]"  |  N   |  M    |  ,    |  .   |   /   | SHIFT |
//                     | ALT  | GUI  | LOWER|  SPACE |  | ENTER | RAISE| BSPC  | GUI   |

// &kp N1 &ext_power EP_TOG &kp N3   &kp N4   &kp N5 &kp N6 &kp N7   &kp N8  &kp N9  &kp N0   &kp A &kp B &kp C &kp D &kp E &kp F &kp G			
			bindings = <
&kp N1 &ext_power EP_TOG &kp N3   &kp N4   &kp N5 &kp N6 &kp N7   &kp N8  &kp N9  &kp N0   &kp A &kp B &kp C &kp D &kp E>;

			sensor-bindings = <&inc_dec_kp C_VOL_UP C_VOL_DN>;

		};
	};
};
