## app/boards/arm/bluesof/Kconfig.board
```kconfig
# BlueSof board configuration

# Copyright (c) 2020 Eric Lau
# SPDX-License-Identifier: MIT

config BOARD_BLUESOF_LEFT
	bool "bluesof_left"
	depends on SOC_NRF52840_QIAA

config BOARD_BLUESOF_RIGHT
	bool "bluesof_right"
	depends on SOC_NRF52840_QIAA
```

## app/boards/arm/bluesof/Kconfig.defconfig
```kconfig
# Copyright (c) 2020 Eric Lau
# SPDX-License-Identifier: MIT

if BOARD_BLUESOF_LEFT

	config ZMK_KEYBOARD_NAME
	default "BlueSof"

endif # BOARD_BLUESOF_LEFT

if BOARD_BLUESOF_RIGHT

	config ZMK_KEYBOARD_NAME
	default "BlueSof (right)"

endif # BOARD_BLUESOF_RIGHT


if BOARD_BLUESOF_LEFT || BOARD_BLUESOF_RIGHT

config BOARD
	default "bluesof"

config ZMK_SPLIT
	default y

menuconfig SENSOR
    bool "Sensor Drivers"

config BT_CTLR
	default BT

config ZMK_BLE
	default y

config ZMK_USB
	default y

config ZMK_BATTERY_VOLTAGE_DIVIDER
	default y

if USB

config USB_NRFX
	default y

config USB_DEVICE_STACK
	default y

endif # USB

config BOARD_ENABLE_DCDC
	bool "Enable DCDC mode"
	select SOC_DCDC_NRF52X
	default y

endif # BOARD_BLUESOF_LEFT || BOARD_BLUESOF_RIGHT
```

## app/boards/shields/test/Kconfig.shield
```kconfig
# Copyright (c) 2020 Pete Johanson
# SPDX-License-Identifier: MIT

config SHIELD_TEST_LEFT
	def_bool $(shields_list_contains,test_left)

config SHIELD_TEST_RIGHT
	def_bool $(shields_list_contains,test_right)
```
