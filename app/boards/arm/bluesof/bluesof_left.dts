/*
 * Copyright (c) 2020 Eric Lau
 *
 * SPDX-License-Identifier: MIT
 */

#include "bluesof.dtsi"

&kscan0 {
	col-gpios
		= <&gpio1 11 GPIO_ACTIVE_HIGH>
		, <&gpio1 10 GPIO_ACTIVE_HIGH>
		, <&gpio0  3 GPIO_ACTIVE_HIGH>
		, <&gpio0 28 GPIO_ACTIVE_HIGH>
		, <&gpio1 13 GPIO_ACTIVE_HIGH>
		, <&gpio0  2 GPIO_ACTIVE_HIGH>
		;
};

&left_encoder {
    status = "okay";
};
